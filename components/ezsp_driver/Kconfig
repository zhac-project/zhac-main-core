## components/ezsp_driver/Kconfig
```kconfig
# SPDX-FileCopyrightText: 2025-2026 Evgenij Cjura and project contributors
# SPDX-License-Identifier: AGPL-3.0-or-later
menu "ZHAC EZSP NCP"
    config ZHAC_EZSP_BACKEND_ENABLE
        bool "EZSP/ASH backend (EXPERIMENTAL — known-broken link layer, see extra/docs/EZSP_ASH_REWORK_PLAN.md)"
        default n
        help
            Compiles the experimental Silicon Labs EZSP/ASH NCP backend
            (components ezsp_driver + ezsp_backend) into the firmware and
            unlocks the "Silicon Labs EmberZNet" option in the NCP Protocol
            choice. The ASH link layer is structurally incomplete (F14):
            no retransmit path, conflated ACK counters, and the response
            semaphore is only serviced from the caller's own poll loop
            (C3/C4 deadlock). Do NOT ship with this enabled — bench
            bring-up only. Rework plan:
            extra/docs/EZSP_ASH_REWORK_PLAN.md (workspace-local).

    if ZHAC_EZSP_BACKEND_ENABLE

    config ZHAC_EZSP_UART_TX_GPIO
        int "EZSP UART TX GPIO pin"
        default 26
        help
            GPIO pin connected to EFR32 NCP UART RX (host TX → NCP RX).
            Default IO26 per UART expansion allocation in GPIO doc.

    config ZHAC_EZSP_UART_RX_GPIO
        int "EZSP UART RX GPIO pin"
        default 27
        help
            GPIO pin connected to EFR32 NCP UART TX (NCP TX → host RX).
            Default IO27 per UART expansion allocation in GPIO doc.

    config ZHAC_EZSP_UART_RST_GPIO
        int "EZSP Reset GPIO pin"
        default 28
        help
            GPIO pin connected to EFR32 NCP nRESET.
            Default IO28 (shared reset line).

    endif # ZHAC_EZSP_BACKEND_ENABLE
endmenu
```

## components/lua_engine/Kconfig
```kconfig
# SPDX-FileCopyrightText: 2025-2026 Evgenij Cjura and project contributors
# SPDX-License-Identifier: AGPL-3.0-or-later
menu "Lua engine"

config LUA_ENGINE_ENABLED
    bool "Enable Lua scripting engine"
    default y

config LUA_ENGINE_HEAP_KB
    int "PSRAM heap budget (KB) for the Lua VM"
    depends on LUA_ENGINE_ENABLED
    default 4096
    range 256 16384
    help
        Hard cap on total allocations charged to the Lua allocator.
        Exceeding this returns NULL from lua_Alloc, which Lua turns
        into `not enough memory` and unwinds safely.

config LUA_ENGINE_INTERNAL_SMALL_THRESHOLD
    int "Internal-RAM threshold for small allocations (bytes)"
    depends on LUA_ENGINE_ENABLED
    default 512
    range 64 4096
    help
        Allocations smaller than this try internal RAM first (fast
        path) and fall back to PSRAM on ENOMEM. Larger allocations
        go straight to PSRAM.

config LUA_ENGINE_MAX_COROUTINES
    int "Max live coroutines"
    depends on LUA_ENGINE_ENABLED
    default 64
    range 4 256

config LUA_ENGINE_TIMER_POOL
    int "Pre-allocated one-shot timer pool size"
    depends on LUA_ENGINE_ENABLED
    default 16
    range 4 64
    help
        Pool of esp_timer_t instances shared by sleeping coroutines.
        If exhausted, `zhac.sleep` returns an error rather than
        allocating.

config LUA_ENGINE_RESUME_QUEUE_DEPTH
    int "Resume queue depth"
    depends on LUA_ENGINE_ENABLED
    default 32
    range 8 256

config LUA_ENGINE_TASK_STACK_BYTES
    int "TaskLua stack size (bytes)"
    depends on LUA_ENGINE_ENABLED
    default 8192
    range 4096 32768

config LUA_ENGINE_TASK_PRIORITY
    int "TaskLua FreeRTOS priority"
    depends on LUA_ENGINE_ENABLED
    default 4
    range 1 20

menu "Curated Lua libraries (preloaded via require)"

config LUA_ENGINE_WITH_CJSON
    bool "lua-cjson (JSON encode/decode)"
    depends on LUA_ENGINE_ENABLED
    default y
    help
        Expose openresty/lua-cjson as `require("cjson")`. Vendored
        under `components/lua_cjson/` (MIT licensed). Provides
        `cjson.encode` / `cjson.decode`, useful for parsing MQTT
        payloads or building structured REST responses from scripts.

config LUA_ENGINE_WITH_LPEG
    bool "LPeg (pattern matching)"
    depends on LUA_ENGINE_ENABLED
    default n
    help
        Expose lua.org/lpeg as `require("lpeg")`. Expects
        `luaopen_lpeg` to link.

config LUA_ENGINE_WITH_MINIZ
    bool "lua-miniz (zlib compress/decompress)"
    depends on LUA_ENGINE_ENABLED
    default n
    help
        Expose luapower/miniz binding as `require("miniz")`.
        Expects `luaopen_miniz` to link.

config LUA_ENGINE_CJSON_DECODE_MAX_DEPTH
    int "cjson.decode max nesting depth"
    depends on LUA_ENGINE_WITH_CJSON
    default 64
    range 4 1000
    help
        Hardens against stack blow-ups when decoding attacker-
        controlled JSON. Applied at module init via
        `cjson.decode_max_depth()`.

endmenu

endmenu
```

## main/Kconfig.projbuild
```kconfig
# SPDX-FileCopyrightText: 2025-2026 Evgenij Cjura and project contributors
# SPDX-License-Identifier: AGPL-3.0-or-later
menu "ZHAC Zigbee NCP Backend"
    choice ZHAC_NCP_BACKEND
        prompt "NCP Protocol"
        default ZHAC_NCP_ZNP

        config ZHAC_NCP_ZNP
            bool "TI Z-Stack NCP (ZNP/MT protocol)"
            help
                CC2652/CC2530 coprocessors using TI's MT serial protocol.

        config ZHAC_NCP_EZSP
            bool "Silicon Labs EmberZNet (EZSP/ASH protocol)"
            help
                EFR32MG coprocessors using Silicon Labs EZSP protocol over ASH framing.

        config ZHAC_NCP_C6
            bool "Espressif ESP32-C6 (ZNCP / esp-zigbee-sdk)"
            help
                ESP32-C6 / ESP32-H2 acting as a Zigbee Network Co-processor
                running the upstream `esp_zigbee_ncp` example firmware.
                See docs/plans/2026-04-25-c6-coprocessor.md.
    endchoice

    menu "ZNP GPIO Pins (CC2652)"
        depends on ZHAC_NCP_ZNP

        config ZHAC_ZNP_UART_TX_GPIO
            int "ZNP UART TX GPIO"
            default 16

        config ZHAC_ZNP_UART_RX_GPIO
            int "ZNP UART RX GPIO"
            default 17

        config ZHAC_ZNP_UART_RST_GPIO
            int "ZNP Reset GPIO"
            default 28

        config ZHAC_ZNP_UART_BSL_GPIO
            int "ZNP BSL GPIO"
            default 29
    endmenu

    menu "C6 GPIO Pins (ESP32-C6 ZNCP)"
        depends on ZHAC_NCP_C6

        config ZHAC_C6_UART_TX_GPIO
            int "C6 UART TX GPIO (P4 → C6)"
            default 16

        config ZHAC_C6_UART_RX_GPIO
            int "C6 UART RX GPIO (C6 → P4)"
            default 17

        config ZHAC_C6_UART_RST_GPIO
            int "C6 Reset GPIO (drives EN/RESET on C6)"
            default 28

        config ZHAC_C6_UART_BAUD
            int "C6 UART baud rate"
            default 460800
            help
                Default 460800 baud matches Espressif's `esp_zigbee_ncp`
                example. Drop to 115200 if signal integrity on the wire
                between the two boards is borderline.
    endmenu
endmenu

menu "ZHAC HAP Diagnostics"
    config HAP_BENCHMARK
        bool "Enable HAP throughput benchmark task"
        default n
        help
            When enabled, P4 boots a one-shot task that sends 1000 small
            HEARTBEAT frames over HAP and logs the achieved frames/sec.
            Used to verify v4 two-stage SPI throughput. Disable in production.
endmenu

menu "ZHAC P4 Buttons"
    config ZHAC_P4_RESET_BTN_GPIO
        int "Zigbee reset button GPIO (long-press 5s = factory reset)"
        default 35
        help
          GPIO 35 is the BOOT button on the ESP32-P4 dev kit. The button is
          also a strapping pin (LOW at boot enters flash mode); task_buttons
          disables the button if it reads LOW at task startup so accidental
          factory reset during flashing is impossible.
          Per docs/esp32_p4_gpio_allocation.md §6.

    config ZHAC_P4_JOIN_BTN_GPIO
        int "Permit-join button GPIO (short-press = open network 254s)"
        default 12
        help
          Per docs/esp32_p4_gpio_allocation.md §6.
endmenu
```

## sdkconfig.defaults
```kconfig
CONFIG_IDF_TARGET="esp32p4"
CONFIG_FREERTOS_HZ=1000
CONFIG_ESP_TASK_WDT_EN=y
CONFIG_ESP_TASK_WDT_TIMEOUT_S=10
CONFIG_ESP_TASK_WDT_CHECK_IDLE_TASK_CPU0=n
CONFIG_SPIRAM=y
CONFIG_ESPTOOLPY_FLASHSIZE_16MB=y
CONFIG_PARTITION_TABLE_CUSTOM=y
CONFIG_PARTITION_TABLE_CUSTOM_FILENAME="partitions.csv"
CONFIG_HTTPD_WS_SUPPORT=y
CONFIG_ESP_COREDUMP_ENABLE_TO_FLASH=y
# F17 (FINDINGS.md): removed CONFIG_ESP_COREDUMP_DATA_FORMAT_ELF and
# _CHECKSUM_CRC32 — both are unknown symbols in IDF v6 (kconfig warned).
# Enabling coredump-to-flash auto-selects the ELF format + SHA256 checksum
# (stronger than the old CRC32 intent), so the explicit lines were ineffective.
CONFIG_ESP_BROWNOUT_DET=y
CONFIG_FREERTOS_WATCHPOINT_END_OF_STACK=y
CONFIG_COMPILER_STACK_CHECK_MODE_STRONG=y
CONFIG_FREERTOS_ISR_STACKSIZE=2096
CONFIG_ESPTOOLPY_FLASHMODE_QIO=y

# Per-core CPU load telemetry (heartbeat cpu_pct_c0 / cpu_pct_c1)
CONFIG_FREERTOS_GENERATE_RUN_TIME_STATS=y
CONFIG_FREERTOS_USE_TRACE_FACILITY=y

# Performance tuning. P4 is RISC-V and uses neither WiFi/lwip nor
# TLS-on-host (S3 does both), so the only meaningful knob is the
# compiler optimization level. -O2 saves ~15% on hot paths
# (zcl encode/decode, JSON build, hap_dispatch, lua bytecode interp).
CONFIG_COMPILER_OPTIMIZATION_PERF=y
CONFIG_MBEDTLS_COMPILER_OPTIMIZATION_PERF=y

# P4 buttons
CONFIG_ZHAC_P4_RESET_BTN_GPIO=35

# PSRAM placement — P4's separate flash/PSRAM buses + L2 cache make
# these essentially free. RODATA shifts const tables (ZHC catalogs,
# string literals) into PSRAM, offloading the flash MMU window and
# improving random-read latency. BSS_SEG_EXTERNAL_MEMORY enables
# EXT_RAM_BSS_ATTR for selected static scratch buffers (s_hap_tx,
# s_rsp_buf) — only safe on non-DMA, non-ISR paths.
CONFIG_SPIRAM_RODATA=y
CONFIG_SPIRAM_ALLOW_BSS_SEG_EXTERNAL_MEMORY=y
```
